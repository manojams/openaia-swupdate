## debian/configs/defconfig
```kconfig
CONFIG_SYSTEMD=y
CONFIG_BOOTLOADER_GRUB=y
CONFIG_GRUBENV_PATH="/boot/grub/grubenv"
CONFIG_BOOTLOADER_DEFAULT_NONE=y
CONFIG_SSL_IMPL_WOLFSSL=y
CONFIG_DOWNLOAD=y
CONFIG_DOWNLOAD_SSL=y
CONFIG_SIGALG_CMS=y
CONFIG_CMS_SKIP_UNKNOWN_SIGNERS=y
CONFIG_ENCRYPTED_IMAGES=y
CONFIG_SURICATTA=y
CONFIG_SURICATTA_SSL=y
CONFIG_SURICATTA_HAWKBIT=y
CONFIG_SURICATTA_GENERAL=y
CONFIG_UPDATE_STATE_CHOICE_BOOTLOADER=y
CONFIG_WEBSERVER=y
CONFIG_MONGOOSESSL=y
CONFIG_ZSTD=y
CONFIG_COPY=y
CONFIG_DISKPART=y
CONFIG_DISKPART_FORMAT=y
CONFIG_DISKFORMAT=y
CONFIG_DISKFORMAT_HANDLER=y
CONFIG_FAT_FILESYSTEM=y
CONFIG_EXT_FILESYSTEM=y
CONFIG_UNIQUEUUID=y
CONFIG_RAW=y
CONFIG_RDIFFHANDLER=y
CONFIG_READBACKHANDLER=y
CONFIG_SHELLSCRIPTHANDLER=y
CONFIG_ARCHIVE=y
CONFIG_BOOTLOADERHANDLER=y
CONFIG_HASH_VERIFY=y
```
